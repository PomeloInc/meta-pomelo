## conf/distro/pomelo-minimal.conf
```bitbake
# Distro Layer configuration
# include and overwrite default poky distro
include conf/distro/poky.conf
DISTRO = "pomelo-minimal"
DISTRO_NAME = "Pommelux-Linux"
DISTRO_VERSION = "0.0"
DISTRO_CODENAME = "Arrabiata"
SDK_VENDOR = "-pomelosdk"
SDK_VERSION="${DISTRO_VERSION}"
MAINTAINER = "info@pomelo.com"

TARGET_VENDOR = "-pomelo"

# Override these in poky based distros
POMMELUX_DEFAULT_DISTRO_FEATURES = "bluetooth ext2 usbgadget usbhost wifi xattr nfs zeroconf 3g"
POMMELUX_DEFAULT_EXTRA_RDEPENDS = "packagegroup-core-boot"
POMMELUX_DEFAULT_EXTRA_RRECOMMENDS = "kernel-module-af-packet"

DISTRO_EXTRA_RDEPENDS += " ${POMMELUX_DEFAULT_EXTRA_RDEPENDS}"
DISTRO_EXTRA_RRECOMMENDS += " ${POMMELUX_DEFAULT_EXTRA_RRECOMMENDS}"

DISTRO_FEATURES ?= "${POMMELUX_DEFAULT_DISTRO_FEATURES} ${DISTRO_FEATURES_LIBC} "

PACKAGE_CLASSES = "package_deb"

# Use systemd as init manager
DISTRO_FEATURES_append = " systemd"
DISTRO_FEATURES_BACKFILL_CONSIDERED += "sysvinit"
VIRTUAL-RUNTIME_init_manager = "systemd"
VIRTUAL-RUNTIME_initscripts = "systemd-compat-units"
```
